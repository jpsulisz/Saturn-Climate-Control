// Task setup
// 1 : COMPLETE : take care of buttons + LEDS
// 2 : COMPLETE : encoder + motor
// 3 : COMPLETE : temperature changing 2
// 4 : screen

#include <Encoder.h>
#include <EEPROM.h>
#include <JC_Button.h>
#include <DHT.h>
#include <Servo.h>
#include <Adafruit_GFX.h>
#include <Adafruit_SSD1306.h>

// BEGIN OF BUTTONS + LEDS INIT

// init of hardwired components

const int button_1 = 5;
const int button_2 = 13;
const int button_3 = 12;

const int led_b1 = 6;
const int led_b2 = 7;
const int led_b3 = 8;

// vars for change

int button_1_state = 0;
int button_2_state = 0;
int button_3_state = 0;

ToggleButton
  button_1_toggle(button_1),
  button_2_toggle(button_2),
  button_3_toggle(button_3);

// END OF BUTTONS + LEDS INIT
// BEGIN OF ENCODER + MOTOR

#define CLK 2
#define DT 3
#define SW 999

long oldRotaryPos = 0;
int oldButtonPos = -1;

Encoder encoder(CLK, DT);

// END OF ENCODER + MOTOR
// BEGIN TEMPERATURE SENSORS

//According to my 98 Dealer Manuals - these are the best ideal temps from the right vent
#define max_temp 100
#define min_temp 40

#define DHTTYPE DHT11
#define DHTPIN 9
DHT dht(DHTPIN, DHTTYPE);

int current_temp_1;
// END TEMPERATURE SENSORS
// BEGIN SERVOs
Servo ServoFan;
Servo ServoTemp;
//#define ServoFan 11
//#define ServoTemp 10
// END SERVOs
// BEGIN SCREEN

const unsigned char Window_IMG [] PROGMEM = {
  // '3_windowvent, 64x64px
  0x00, 0x00, 0x00, 0x00, 0x00, 0x00, 0x00, 0x00, 0x00, 0x00, 0x00, 0x00, 0x00, 0x00, 0x00, 0x00, 
  0x00, 0x00, 0x00, 0x00, 0x00, 0x00, 0x00, 0x00, 0x00, 0x00, 0x00, 0x00, 0x00, 0x00, 0x00, 0x00, 
  0x00, 0x00, 0x00, 0x00, 0x00, 0x00, 0x00, 0x00, 0x00, 0x00, 0x00, 0x00, 0x00, 0x00, 0x00, 0x00, 
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  0x00, 0x00, 0x00, 0x00, 0x00, 0x00, 0x00, 0x00, 0x00, 0x00, 0x00, 0x00, 0x00, 0x00, 0x00, 0x00
};

// '0_torso', 64x64px
const unsigned char IMG0 [] PROGMEM = {
  0x00, 0x00, 0x00, 0x00, 0x00, 0x00, 0x00, 0x00, 0x00, 0x00, 0x00, 0x00, 0x00, 0x00, 0x00, 0x00, 
  0x00, 0x00, 0x00, 0x00, 0x00, 0x00, 0x00, 0x00, 0x00, 0x00, 0x00, 0x00, 0x00, 0x00, 0xfc, 0x00, 
  0x00, 0x00, 0x00, 0xf0, 0x00, 0x03, 0xfe, 0x00, 0x00, 0x00, 0x00, 0xfc, 0x00, 0x07, 0xff, 0x00, 
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  0x00, 0x00, 0x00, 0x00, 0x00, 0x00, 0x00, 0x00, 0x00, 0x00, 0x00, 0x00, 0x00, 0x00, 0x00, 0x00
};
// '1_leg', 64x64px
const unsigned char IMG1 [] PROGMEM = {
  0x00, 0x00, 0x00, 0x00, 0x00, 0x00, 0x00, 0x00, 0x00, 0x00, 0x00, 0x00, 0x00, 0x00, 0x00, 0x00, 
  0x00, 0x00, 0x00, 0x00, 0x00, 0x00, 0x00, 0x00, 0x00, 0x00, 0x00, 0x00, 0x00, 0x00, 0xfc, 0x00, 
  0x00, 0x00, 0x00, 0x00, 0x00, 0x03, 0xfe, 0x00, 0x00, 0x00, 0x00, 0x00, 0x00, 0x07, 0xff, 0x00, 
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  0x00, 0x00, 0x00, 0x00, 0x00, 0x00, 0x00, 0x00, 0x00, 0x00, 0x00, 0x00, 0x00, 0x00, 0x00, 0x00
};
// '3_both', 64x64px
const unsigned char IMG3 [] PROGMEM = {
  0x00, 0x00, 0x00, 0x00, 0x00, 0x00, 0x00, 0x00, 0x00, 0x00, 0x00, 0x00, 0x00, 0x00, 0x00, 0x00, 
  0x00, 0x00, 0x00, 0x00, 0x00, 0x00, 0x00, 0x00, 0x00, 0x00, 0x00, 0x00, 0x00, 0x00, 0xfc, 0x00, 
  0x00, 0x00, 0x00, 0xf0, 0x00, 0x03, 0xfe, 0x00, 0x00, 0x00, 0x00, 0xfc, 0x00, 0x07, 0xff, 0x00, 
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  0x00, 0x00, 0x00, 0x00, 0x00, 0x00, 0x00, 0x00, 0x00, 0x00, 0x00, 0x00, 0x00, 0x00, 0x00, 0x00
};
// '4_wndlower', 64x64px
const unsigned char IMG4 [] PROGMEM = {
  0x00, 0x00, 0x00, 0x00, 0x00, 0x00, 0x00, 0x00, 0x00, 0x00, 0x00, 0x00, 0x00, 0x00, 0x00, 0x00, 
  0x00, 0x00, 0x00, 0x00, 0x00, 0x00, 0x00, 0x00, 0x00, 0x00, 0x0b, 0xf0, 0x00, 0x00, 0xfc, 0x00, 
  0x00, 0x00, 0x7f, 0xff, 0x80, 0x03, 0xfe, 0x00, 0x00, 0x03, 0xff, 0xff, 0xf0, 0x07, 0xff, 0x00, 
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  0x00, 0x00, 0x00, 0x00, 0x00, 0x00, 0x00, 0x00, 0x00, 0x00, 0x00, 0x00, 0x00, 0x00, 0x00, 0x00
};


#define SCREEN_WIDTH 128 // OLED display width, in pixels
#define SCREEN_HEIGHT 64 // OLED display height, in pixels

// Declaration for an SSD1306 display connected to I2C (SDA, SCL pins)
#define OLED_RESET     4 // Reset pin # (or -1 if sharing Arduino reset pin)
Adafruit_SSD1306 display(SCREEN_WIDTH, SCREEN_HEIGHT, &Wire, OLED_RESET);

#define LOGO_HEIGHT   16
#define LOGO_WIDTH    16

// END SCREEN
void setup() {
  //init serial communication at 9600 bits per second:
  Serial.begin(9600);
  //init testing LEDs for diagnosis
  digitalWrite(led_b1, HIGH);
  digitalWrite(led_b2, HIGH);
  digitalWrite(led_b3, HIGH);
  delay(500);
  digitalWrite(led_b1, LOW);
  digitalWrite(led_b2, LOW);
  digitalWrite(led_b3, LOW);
  //init the LED pins as outputs:
  pinMode(led_b1, OUTPUT);
  pinMode(led_b2, OUTPUT);
  pinMode(led_b3, OUTPUT);
  //init the button pins as inputs:
  pinMode(button_1, INPUT);
  pinMode(button_2, INPUT);
  pinMode(button_3, INPUT);
  //JC Button setup to begin reading button for toggle
  button_1_toggle.begin();
  button_2_toggle.begin();
  button_3_toggle.begin();
  //Begin temperature sensor
  dht.begin();
  //Attach servos
  ServoFan.attach(11);
  ServoTemp.attach(10);
  //Screen init
  
  // SSD1306_SWITCHCAPVCC = generate display voltage from 3.3V internally
  if(!display.begin(SSD1306_SWITCHCAPVCC, 0x3C)) { // Address 0x3D for 128x64
    Serial.println(F("SSD1306 allocation failed"));
    for(;;); // Don't proceed, loop forever
  }

  // Show initial display buffer contents on the screen --
  // the library initializes this with an Adafruit splash screen.
  display.display();
  delay(2000); // Pause for 2 seconds

  // Clear the buffer
  display.clearDisplay();

  // Draw a single pixel in white
  display.drawPixel(10, 10, SSD1306_WHITE);

  // Show the display buffer on the screen. You MUST call display() after
  // drawing commands to make them visible on screen!
  display.display();
}

void loop() {
  button_read();
  encoder_read();
  temperature_read();
  servo_control();
  screen_display();
}

void screen_display(){
    int desired_temp = EEPROM.read(1);
    int previous_button = EEPROM.read(0); // reads on startup
 
    display.clearDisplay();
    display.setTextSize(3);
    display.setTextColor(WHITE);
    display.setCursor(5,20);
    if(desired_temp == max_temp){
      display.println("HOT");
    }else if(desired_temp == min_temp){
      display.println("CHL");
    }else{
      display.print(desired_temp);display.println((char)247);
    }
    //display.println(previous_button);
    //display.display();
    if(previous_button == 2){
      display.drawBitmap(64,0, Window_IMG, 64, 64, WHITE);
      display.display();
    }else if(previous_button == 0)
    {
      display.drawBitmap(64,0, IMG0, 64, 64, WHITE);
      display.display();
    }else if(previous_button == 1)
    {
      display.drawBitmap(64,0, IMG1, 64, 64, WHITE);
      display.display();
    }
    else if(previous_button == 3)
    {
      display.drawBitmap(64,0, IMG3, 64, 64, WHITE);
      display.display();
    }
    else if(previous_button == 4)
    {
      display.drawBitmap(64,0, IMG4, 64, 64, WHITE);
      display.display();
    }
}

void servo_control(){
  /*
   * Writes info for Fan position and temperature
   */
  //ServoFan.write(0);
  //ServoTemp.write(0);
  //Begin Fan position control
  int previous_button = EEPROM.read(0); // reads on startup
  int fan_angle [5] = {0, 50, 100, 140, 180};
  ServoFan.write(fan_angle[previous_button]);
  //Begin temp position control
  int desired_temp = EEPROM.read(1);
  int diff_temp = current_temp_1 - desired_temp;
  if(diff_temp < 2 && diff_temp > 2){ // no difference, set at middle
    ServoTemp.write(90);
  }else if(diff_temp < -6){
    ServoTemp.write(180);
  }else if(diff_temp > 6){
    ServoTemp.write(0);
  }else{
    int custom_angle = diff_temp*10;
    custom_angle = map(custom_angle, -150, 150, 180, 0);
    ServoTemp.write(custom_angle);
  }
}

void temperature_read(){
  if(! isnan(dht.readTemperature())){
    current_temp_1 = dht.readTemperature(true);
  }
}

void button_read() {
  /*Information:
    Button 1:
      -Far left
      -Torso vent only
      -Connects to button 2 (leg)
    Button 2:
      -Middle vent
      -Leg vent only
      -Can connect to button 1 (Torso) + 3 (Window)
    Button 3:
      -Far right vent
      -Window vent only
      -Can connect to button 3 (Legs)
      
    Requirements:
      - Button combos (1 and 2) + (3 and 2) can be on simultaneously to have both of their vents on
      - Non-combo buttons can't be on at the same time (1 and 3)
      - If a button is 'active' then their respective LED should be illuminated (HIGH)
      - Write to EEPROM to save on the case of power failure (car off)
      - Flash possible combo button to show user possible combination

      - Button combinations should save to address 0 of EEPROM:
        - 0 (default if failure): Torso only (Button 1) ( 1 0 0 )
        - 1 : Middle vent only (button 2) ( 0 1 0 )
        - 2 : Window vent only (button 3) ( 0 0 1 )
        - 3 : Button 1 + 2 ( 1 1 0 )
        - 4 : Button 3 + 2 ( 0 1 1 )
  */

  button_1_toggle.read();
  button_2_toggle.read();
  button_3_toggle.read();

  int previous_button = EEPROM.read(0); // reads on startup
  
  if(button_1_toggle.changed()){
    EEPROM.update(0,0);
    if(previous_button == 1){
      EEPROM.update(0,3);
    }else if(previous_button == 3){
      EEPROM.update(0,1);
    }
  }
  if(button_2_toggle.changed()){
    if(previous_button == 3){
      EEPROM.update(0,0);
    }else if(previous_button == 4){
      EEPROM.update(0,2);
    }else if(previous_button == 0){
      EEPROM.update(0, 3);
    }else if(previous_button == 2){
      EEPROM.update(0, 4);
    }else{
      EEPROM.update(0, 1);
    }
  }
  if(button_3_toggle.changed()){
    EEPROM.update(0,2);
    if(previous_button == 1){
      EEPROM.update(0, 4);
    }else if(previous_button == 4){
      EEPROM.update(0, 1);
    }
  }

  
  previous_button = EEPROM.read(0);
  
  if(oldButtonPos != previous_button){
    if(previous_button == 0){
      digitalWrite(led_b1, HIGH);
      digitalWrite(led_b2, LOW);
      digitalWrite(led_b3, LOW);
    }else if (previous_button == 1){
      digitalWrite(led_b1, LOW);
      digitalWrite(led_b2, HIGH);
      digitalWrite(led_b3, LOW);
    }else if (previous_button == 2){
      digitalWrite(led_b1, LOW);
      digitalWrite(led_b2, LOW);
      digitalWrite(led_b3, HIGH);
    } else if (previous_button == 3){
      digitalWrite(led_b1, HIGH);
      digitalWrite(led_b2, HIGH);
      digitalWrite(led_b3, LOW);
    }else if (previous_button == 4){
      digitalWrite(led_b1, LOW);
      digitalWrite(led_b2, HIGH);
      digitalWrite(led_b3, HIGH);
    }
    oldButtonPos = previous_button;
  }
}

void encoder_read() {
  /*
   * Each 'click' is 4 positions
   */
  int user_temperature = EEPROM.read(1); // reads stored temperature
  long newRotaryPos = encoder.read() / 4; //divide by 4 to fix encoder skipping 4 per click
  if(newRotaryPos != oldRotaryPos){
    if((newRotaryPos > oldRotaryPos)&&(user_temperature>min_temp)){
      user_temperature = user_temperature - 1;
    }else if (user_temperature<max_temp){
      user_temperature = user_temperature + 1;
    }
    if(user_temperature>max_temp || user_temperature<min_temp){
      user_temperature = 70;
    }
    EEPROM.put(1, user_temperature);
    oldRotaryPos = newRotaryPos;
  }
}
